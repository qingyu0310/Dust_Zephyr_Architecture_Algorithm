## Kconfig
```kconfig
# algorithm/Kconfig — 算法与控制器
# 提供 PID/功率控制/滤波器/参数辨识等计算模块
# 不直接依赖硬件，可在仿真或离线环境中使用
# 头文件在 algorithm/controller/ 和 algorithm/identify/ 下
config CTL_TIMER
    bool "软件定时器"
    default n
    help
        软件定时器

config CTL_PID
    bool "PID控制器"
    default n
    help
        位置式PID控制器，支持微分先行/积分分离/变速积分/D项低通滤波

config FLT_LPF
    bool "信号滤波器"
    default n
    help
        一阶低通滤波器

config ID_RLS
    bool "递归最小二乘法"
    default n
    help
        递归最小二乘法

config MOD_CTL_POWER
    bool "功率控制器"
    default n
    select CTL_PID
    select ID_RLS
    select FLT_LPF
    help
        电机功率控制，包含功率模型预测/RLS参数辨识/隶属度分配/受限力矩求解
```

## tflm/Kconfig
```kconfig
config TFLM
    bool "TensorFlow Lite Micro"
    default n
    select CPP
    select REQUIRES_FULL_LIBCPP

if TFLM

config TFLM_ARENA_SIZE
    int "Tensor arena size (bytes)"
    default 3000
    range 2048 1048576

endif
```
